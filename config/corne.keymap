/*
*
* Copyright (c) 2021 Darryl deHaan
* SPDX-License-Identifier: MIT
*
*/

#include <behaviors.dtsi>
#include <dt-bindings/zmk/rgb.h>
#include <dt-bindings/zmk/keys.h>
#include <dt-bindings/zmk/bt.h>
#include <dt-bindings/zmk/outputs.h>
#include <dt-bindings/zmk/ext_power.h>


/* use helper macros to define left and right hand keys */
#include "../zmk-nodefree-config/helper.h"
#include "../zmk-nodefree-config/keypos_def/keypos_42keys.h"

#define KEYS_L LT0 LT1 LT2 LT3 LT4 LT5 LM0 LM1 LM2 LM3 LM4 LM5 LB0 LB1 LB2 LB3 LB4  LB5 // left-hand keys
#define KEYS_R RT0 RT1 RT2 RT3 RT4 RT5 RM0 RM1 RM2 RM3 RM4 RM5 RB0 RB1 RB2 RB3 RB4 RB5  // right-hand keys
#define THUMBS LH2 LH1 LH0 RH0 RH1 RH2                                      // thumb keys

/* left-hand HRMs */


ZMK_BEHAVIOR(hml, hold_tap,
    flavor = "balanced";
    tapping-term-ms = <200>;
    quick-tap-ms = <175>;                // repeat on tap-into-hold
    require-prior-idle-ms = <150>;
    bindings = <&kp>, <&kp>;
    hold-trigger-key-positions = <KEYS_R THUMBS>;
    hold-trigger-on-release;             // delay positional check until key-release
)

/* right-hand HRMs */
ZMK_BEHAVIOR(hmr, hold_tap,
    flavor = "balanced";
    tapping-term-ms = <200>; // was 280
    quick-tap-ms = <175>;                // repeat on tap-into-hold
    require-prior-idle-ms = <150>;
    bindings = <&kp>, <&kp>;
    hold-trigger-key-positions = <KEYS_L THUMBS>;
    hold-trigger-on-release;             // delay positional check until key-release
)

&soft_off {
    hold-time-ms = <3000>; // Only turn off it the key is held for 5 seconds or longer.
};

/ {
		macros {
        go_here_please: go_here_please {
					label = "ZM_go_here_please";
            				compatible = "zmk,behavior-macro";
            				#binding-cells = <0>;
            				bindings
                				= <&mo 4>;
        			};
        assign_operator: assign_operator {
					label = "ZM_assign_operator";
            				compatible = "zmk,behavior-macro";
            				#binding-cells = <0>;
            				bindings
                				= <&kp COLON &kp EQUAL>;
        			};

				assign_left: assign_left {
					label = "ZM_assign_left";
            				compatible = "zmk,behavior-macro";
            				#binding-cells = <0>;
            				bindings
                				= <&kp LT &kp MINUS>;
        			};
				assign_right: assign_right {
					label = "ZM_assign_right";
            				compatible = "zmk,behavior-macro";
            				#binding-cells = <0>;
            				bindings
                				= <&kp MINUS &kp GT>;
				};
				rust_match: rust_match {
					label = "ZM_rust_match";
            				compatible = "zmk,behavior-macro";
            				#binding-cells = <0>;
            				bindings
                				= <&kp EQUAL &kp GT>;
        			};
				};

};


/ {
  chosen {
    zmk,matrix_transform = &default_transform;
    //zmk,matrix_transform = &five_column_transform;
  };
};

/ {
        keymap {
                compatible = "zmk,keymap";

                default_layer {
                        label = "DVORAK";
// -----------------------------------------------------------------------------------------
// | \ |  ' |  ,  |  .  |  p  |  y  |   |  F  |  G   |  C  |  R  |  L  | ? /  |
// | ESC |  a  |  o  |  e  |  u  |  i  |   |  D  |  H   |  T  |  N  |  S  | TAB  |
// | `~ | ;  |  q  |  j  |  k  |  x  |   |  b  |  m   |  w  |  v  |  z  | CAPS |
//                    | GUI | SPC | LWR |   | RSE | ENT  | BKSP |
                        bindings = <
   &mt &soft_off BACKSLASH &kp SQT &kp COMMA &lt 4 DOT  &kp P &kp Y   &kp F &kp G  &kp C  &kp R   &kp L &kp SLASH
   &kp ESC &hml LGUI A &hml LALT O &hml LCTRL E &hml LSHIFT U &kp I   &kp D &hmr RSHIFT H  &hmr RCTRL T &hmr RALT N  &hmr LGUI S &kp TAB
   &kp GRAVE &kp SEMI &kp Q &kp J &kp K &kp X   &kp B &kp M  &kp W &kp V &kp Z &kp CAPS
                  &kp LGUI &kp SPACE &mo 2   &mo 1 &kp RET &kp BKSP
                        >;
                };
                lower_layer {
                        label = "NUMBER";
// -----------------------------------------------------------------------------------------
// | ;  | , |  -    |  +    |  .   | :   |   | BTCLR| BT1 | BT2 | BT3 | BT4 | BT5  |   
// |  ESC |  1  |  2    |  3    |  4    |  5    |   |  6   |  7  |  8  |  9  |  0  | ESC  |
// | outTog | rgbn| rgb d | rgbt  | rgb i | pw_tg |   | prev| vol-| play| vol+| next |      |
//                    | GUI | SPC |     |   | GUI | RET | BKSP |
                        bindings = <
   &kp SEMI &kp  COMMA &kp MINUS  &kp PLUS &kp DOT &kp COLON      &bt BT_CLR &bt BT_SEL 0 &bt BT_SEL 1 &bt BT_SEL 2 &bt BT_SEL 3 &bt BT_SEL 4   
   &kp ESC &hml LGUI N1 &hml LALT N2 &hml LCTRL N3 &hml LSHIFT N4 &kp N5      &kp N6 &hmr RSHIFT N7 &hmr RCTRL N8 &hmr RALT N9 &kp N0 &kp ESC
   &out OUT_TOG  &rgb_ug RGB_EFF   &rgb_ug RGB_HUD   &rgb_ug RGB_TOG  &rgb_ug RGB_HUI &ext_power EP_TOG &kp C_PREV &kp C_VOLUME_DOWN &kp C_PLAY_PAUSE &kp C_VOL_UP &kp C_NEXT  &trans
                          	        &kp LGUI     &kp SPACE    &trans      &kp LGUI  &kp RET   &kp BKSP
                        >;
                };

                raise_layer {
                        label = "SYMBOL";
// -----------------------------------------------------------------------------------------
// |  TAB |     |  -  |  +  |  *  |  &  |   |  ^  |  [  |  ]  |     |     | BKSP |
// | CTRL |  !  |  @  |  #  |  $  |  %  |   |  =  |  (  |  )  |     |  \  |  `   |
// | SHFT |     | <-  | ->  | =>  | :=  |   |  _  |  {  |  }  |     | "|" |  ~   |
//                    | GUI | SPC |     |   |     | RET | BKSP |
                        bindings = <
   &kp LCTRL &trans &kp MINUS  &kp PLUS &kp STAR &kp AMPS &kp CARET &kp LBKT &kp RBKT &none &none &none
   &kp  TAB  &kp EXCL &kp AT &kp HASH &kp DLLR &kp PRCNT &kp EQUAL &kp LPAR  &kp RPAR &none &none &kp BSPC
   &kp LSHFT &trans &assign_left &assign_right  &rust_match  &assign_operator  &kp UNDER &kp LBRC &kp RBRC &none &kp PIPE &kp TILDE
                    	     &kp LGUI &kp SPACE   &trans   &mo 3   &trans    &kp RALT
                        >;
                };


                  // Function keys with modifiers
       		      fnc_layer {
                      label = "FUNC";
		                  bindings = <
		&trans &sk LALT &sk LSHIFT  &sk LGUI &sk LCTRL &kp RALT     &trans &trans &kp PRINTSCREEN &trans &trans &trans
		&kp F1 &kp F2 &kp F3 &kp F4 &kp F5 &kp F6             &kp F7 &kp F8 &kp F9 &kp F10 &kp F11 &kp F12 
		&none &none &none &none &none &none                   &none &none &none &none &none &none
                    	     &kp LGUI &kp SPACE   &trans   &trans   &trans    &kp RALT
		                    >;
		            };

                arrow_layer {
                        label = "ARROW";
// -----------------------------------------------------------------------------------------
// |  TAB |     |  -  |  +  |  *  |  &  |   |  ^  |  [  |  ]  |     |     | BKSP |
// | CTRL |  !  |  @  |  #  |  $  |  %  |   |  =  |  (  |  )  |     |  \  |  `   |
// | SHFT |     | <-  | ->  | =>  |     |   |  _  |  {  |  }  |     | "|" |  ~   |
//                    | GUI | SPC |     |   |     | RET | BKSP |
                        bindings = <
		&none &none &none &none &none &none                   &none &none &none &none &none &none
		&none &none &none &none &kp LALT &none                   &none &kp LEFT &kp DOWN &kp UP &kp RIGHT &none
		&none &none &none &none &none &none                   &none &none &none &none &none &none
                    	     &kp LGUI &kp LALT  &trans   &mo 3   &kp RSHIFT    &kp RALT
                        >;
                };

        };
};
